## CMakeLists.txt
```
# SPDX-License-Identifier: Apache-2.0

cmake_minimum_required(VERSION 3.20.0)

set_property(GLOBAL APPEND PROPERTY HEX_FILES_TO_MERGE
      ${app_provision_hex})

# Suppress "simple_bus_reg" on Pico boards as all GPIO ports use the same register.
list(APPEND EXTRA_DTC_FLAGS "-Wno-simple_bus_reg")

set(BOARD rpi_pico_w)

find_package(Zephyr)
project(counter)

target_sources(app PRIVATE src/main.c)

# zephyr_compile_options(-save-temps)
```

## prj.conf
```kconfig
# This config needed to bring in hardware/timer.h code
CONFIG_COUNTER=y

CONFIG_DEBUG=y
CONFIG_GPIO=y
CONFIG_BOOT_BANNER_STRING="Booting Counter"

#------------------------------------------------

CONFIG_LOG=y
CONFIG_LOG_DEFAULT_LEVEL=3
CONFIG_LOG_OVERRIDE_LEVEL=0
CONFIG_LOG_MAX_LEVEL=4
CONFIG_LOG_FUNC_NAME_PREFIX_DBG=y
CONFIG_LOG_PRINTK=y
CONFIG_LOG_MODE_OVERFLOW=y
CONFIG_LOG_PROCESS_TRIGGER_THRESHOLD=30
CONFIG_LOG_PROCESS_THREAD=y
CONFIG_LOG_PROCESS_THREAD_SLEEP_MS=1000
CONFIG_LOG_PROCESS_THREAD_STACK_SIZE=768
CONFIG_LOG_BUFFER_SIZE=2048
CONFIG_LOG_DOMAIN_ID=0

# Comment out if not using RTT
CONFIG_USE_SEGGER_RTT=y
CONFIG_SEGGER_RTT_MAX_NUM_UP_BUFFERS=5
CONFIG_SEGGER_RTT_MAX_NUM_DOWN_BUFFERS=5
CONFIG_SEGGER_RTT_BUFFER_SIZE_UP=2048
CONFIG_SEGGER_RTT_BUFFER_SIZE_DOWN=16
CONFIG_SEGGER_RTT_PRINTF_BUFFER_SIZE=64
CONFIG_SEGGER_RTT_MODE_NO_BLOCK_SKIP=y
CONFIG_LOG_BACKEND_RTT=y
CONFIG_LOG_BACKEND_RTT_MODE_DROP=y
CONFIG_LOG_BACKEND_RTT_BUFFER=0
CONFIG_LOG_BACKEND_SHOW_COLOR=y
CONFIG_LOG_BACKEND_RTT_MESSAGE_SIZE=128

CONFIG_LOG_BACKEND_UART=y
CONFIG_LOG_BACKEND_FORMAT_TIMESTAMP=n
CONFIG_LOG_BACKEND_SHOW_COLOR=n
```

## src/main.c
```c
/*
 * Copyright (c) 2016 Intel Corporation
 *
 * SPDX-License-Identifier: Apache-2.0
 */

#include <zephyr/kernel.h>
#include <zephyr/drivers/gpio.h>
#include <hardware/timer.h>

#include <zephyr/logging/log.h>
LOG_MODULE_REGISTER(main, 3);

#define SLEEP_TIME_MS   1000

void pause_timer(int pause)
{
	timer_hw->pause = pause;
}

void zero_timer(void)
{
	timer_hw->timehw = 0;
	timer_hw->timelw = 0;
}

int main(void)
{
	LOG_INF("main: starting...");
	uint64_t mytime;

	pause_timer(true);
	zero_timer();
	pause_timer(false);

	while (1) {
		mytime = time_us_64();
		LOG_INF("value of mytime = %lld", mytime);
		k_msleep(1000);
	}
	return 0;
}
```
